## Kconfig
```kconfig
config USR_LIB_USBCTRL
  bool  "userspace USB portable control stack"
  default y
  ---help---
  Support for communication with USB device driver(s), handling
  USB control interface and registering multiple USB interfaces

if USR_LIB_USBCTRL

menu "libxDCI specific options"

config USR_LIB_USBCTRL_DEV_VENDORID
  hex "USB Vendor Identifier"
  default 0xDEAD
  ---help---
  Device vendor identifier (VID value of [VID:PID] pair)


if !USR_LIB_USBCTRL_DIFFERENCIATE_DFU_FW_BUILD

config USR_LIB_USBCTRL_FW_DEV_PRODUCTID
  hex "USB Product Identifier"
  default 0xCAFE
  ---help---
  Device  product identifier (PID value of [VID:PID] pair)

endif


config USR_LIB_USBCTRL_DIFFERENCIATE_DFU_FW_BUILD
  bool "Make Firmware and DFU mode features differenciated"
  default n
  ---help---
  libxDCI allows to handle some variations between FW and DFU mode, making DFU and FW
  libxDCI footprint, performances, debug levels dedicated to each mode.
  This simplifies the stack debugging, reducies the needed storage content to the one
  requested in the given mode, and make USB informations (product name, device name and
  so on) being mode-specific.


if USR_LIB_USBCTRL_DIFFERENCIATE_DFU_FW_BUILD
# differenciate FW/DFU build case

menu "Firmware-mode specific configuration"

config USR_LIB_USBCTRL_FW_DEBUG
  bool "Activate debuggging for Firmware-mode USB Control interaction"
  default n
  ---help---
  Activate various debugging for usb control interaction.
  This option is efficient only if KERNEL_SERIAL is activated.

config USBCTRL_FW_MAX_CFG
  int "Max number of independent configurations in Firmware mode"
  default 1
  ---help---
  This define the maximum number of USB alternative configurations. Each
  configuration hold one or more interface(s), each handling a list of
  endpoint and an associated USB class.

config USBCTRL_FW_MAX_CTX
  int "Max number of concurrent contexts supported in firmware mode"
  default 2
  ---help---
  This define the maximum number of USB context (meaning USB physical interfaces)
  that the libusbctrl can handle in the same time.
  Depending on the hardware (and software) design, it can be 1, 2 or in some rare
  time more.config USB_FW_DEV_VENDORID
  hex "USB Vendor Identifier"
  default 0xDEAD
  ---help---
  Device vendor identifier (VID value of [VID:PID] pair)

config USR_LIB_USBCTRL_FW_DEV_PRODUCTID
  hex "USB Product Identifier"
  default 0xCAFE
  ---help---
  Device  product identifier (PID value of [VID:PID] pair)


endmenu

menu "DFU-mode specific configuration"

config USR_LIB_USBCTRL_DFU_DEBUG
  bool "Activate debuggging for DFU-mode USB Control interaction"
  default n
  ---help---
  Activate various debugging for usb control interaction.
  This option is efficient only if KERNEL_SERIAL is activated.



config USBCTRL_DFU_MAX_CFG
  int "Max number of independent configurations in DFU mode"
  default 1
  ---help---
  This define the maximum number of USB alternative configurations. Each
  configuration hold one or more interface(s), each handling a list of
  endpoint and an associated USB class.


config USBCTRL_DFU_MAX_CTX
  int "Max number of concurrent contexts supported in DFU mode"
  default 2
  ---help---
  This define the maximum number of USB context (meaning USB physical interfaces)
  that the libusbctrl can handle in the same time.
  Depending on the hardware (and software) design, it can be 1, 2 or in some rare
  time more.

config USR_LIB_USBCTRL_DFU_DEV_PRODUCTID
  hex "USB Product Identifier"
  default 0xCAFE
  ---help---
  Device  product identifier (PID value of [VID:PID] pair)



endmenu

endif

if !USR_LIB_USBCTRL_DIFFERENCIATE_DFU_FW_BUILD
# unified FW/DFU build case

config USR_LIB_USBCTRL_DEBUG
  bool "Activate debuggging for USB Control interaction"
  default n
  ---help---
  Activate various debugging for usb control interaction.
  This option is efficient only if KERNEL_SERIAL is activated.


config USBCTRL_MAX_CFG
  int "Max number of independent configurations"
  default 1
  ---help---
  This define the maximum number of USB alternative configurations. Each
  configuration hold one or more interface(s), each handling a list of
  endpoint and an associated USB class.



config USBCTRL_MAX_CTX
  int "Max number of concurrent contexts supported"
  default 2
  ---help---
  This define the maximum number of USB context (meaning USB physical interfaces)
  that the libusbctrl can handle in the same time.
  Depending on the hardware (and software) design, it can be 1, 2 or in some rare
  time more.

endif

config USBCTRL_EP0_FIFO_SIZE
   int "USB control pipe default reception FIFO size (in bytes)"
   default 128
   ---help---
   Specify the receive RAM FIFO size for USB control pipe of the libctrl.
   This FIFO size must be at least equal to 3*(ctrl pkt) + 1

config USB_DEV_PRODNAME
  string "USB device product name"
  default "wookey"
  ---help---
  Device product name, as shown to the host

config USB_DEV_MANUFACTURER
  string "USB Manufacturer name"
  default "ANSSI"
  ---help---
  Device product manufacturer, as shown to the host

# fIXME: permit autogenerated serial instead of fixed
config USB_DEV_SERIAL
  string "USB Serial value"
  default "123456789012345678901234"
  ---help---
  Device serial number

config USB_DEV_REVISION
  string "USB Device Revision"
  default "0001"
  ---help---
  Device current revision

# automatically built blocks
# index of prodname in sent descriptor table
config USB_DEV_PRODNAME_INDEX
  int
  default 1
  ---help---
  Device product name index in descriptor.

# index of manufacturer in sent descriptor table
config USB_DEV_MANUFACTURER_INDEX
  int
  default 2

# index of serial number in sent descriptor table
config USB_DEV_SERIAL_INDEX
  int "USB device serial index"
  default 3

endmenu

endif
```
